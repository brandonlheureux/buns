## boards/shields/buns/Kconfig.defconfig
```kconfig
if SHIELD_BUNS_LEFT

# Name must be less than 16 characters long!
config BUNS
    string "Buns name" 
    default "Buns"

config ZMK_SPLIT_ROLE_CENTRAL
    bool "Enable split central role"
    default y

endif

if SHIELD_BUNS_LEFT || SHIELD_BUNS_RIGHT

config ZMK_SPLIT
    bool "Enable split keyboard"
    default y

endif

if SHIELD_BUNS_RIGHT

config ZMK_SPLIT_ROLE_PERIPHERAL
    bool "Enable split peripheral role"
    default y

endif
```

## boards/shields/buns/Kconfig.shield
```kconfig
# No whitespace after the comma or in your part name!
config BUNS_LEFT
    def_bool $(shields_list_contains,buns_left)

# No whitespace after the comma or in your part name!
config BUNS_RIGHT
    def_bool $(shields_list_contains,buns_right)
```
